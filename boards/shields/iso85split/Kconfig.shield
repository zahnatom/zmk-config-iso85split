## boards/shields/iso85split/Kconfig.shield
```kconfig
config SHIELD_ISO85SPLIT_LEFT
    def_bool $(shields_list_contains,iso85split_left)

config SHIELD_ISO85SPLIT_RIGHT
    def_bool $(shields_list_contains,iso85split_right)

config SHIELD_ISO85SPLIT_DONGLE
    def_bool $(shields_list_contains,iso85split_dongle)
```

## config/boards/shields/iso85split/Kconfig.defconfig
```kconfig
if SHIELD_ISO85SPLIT_DONGLE

config ZMK_KEYBOARD_NAME
    default "ISO 85 Split"

config ZMK_SPLIT_ROLE_CENTRAL
    default y

# config ZMK_USB
#     default n    

endif

if SHIELD_ISO85SPLIT_LEFT || SHIELD_ISO85SPLIT_RIGHT || SHIELD_ISO85SPLIT_DONGLE
    
    config ZMK_SPLIT 
        default y

endif

if SHIELD_ISO85SPLIT_LEFT || SHIELD_ISO85SPLIT_RIGHT

    config ZMK_PM_SOFT_OFF
        default y

endif
```

## config/boards/shields/iso85split/Kconfig.shield
```kconfig
config SHIELD_ISO85SPLIT_LEFT
    def_bool $(shields_list_contains,iso85split_left)

config SHIELD_ISO85SPLIT_RIGHT
    def_bool $(shields_list_contains,iso85split_right)
    select SPI

config SHIELD_ISO85SPLIT_DONGLE
    def_bool $(shields_list_contains,iso85split_dongle)
```
