#include "iso85split.dtsi"

&kscan0 {
    col-gpios = <&gpio1 15 (GPIO_ACTIVE_HIGH)>,
                <&gpio1 14 (GPIO_ACTIVE_HIGH)>,
                <&gpio1 13 (GPIO_ACTIVE_HIGH)>,
                <&gpio1 12 (GPIO_ACTIVE_HIGH)>,
                <&gpio0 9 (GPIO_ACTIVE_HIGH)>,
                <&gpio0 10 (GPIO_ACTIVE_HIGH)>;
};

keys {
    compatible = "gpio-keys";
    wakeup_key: wakeup_key {
        gpios = <&gpio1 11 (GPIO_ACTIVE_LOW | GPIO_PULL_UP)>;
    };
};