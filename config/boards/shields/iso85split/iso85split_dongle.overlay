#include "iso85split.dtsi"

&kscan0 {
    col-gpios = <&gpio1 15 (GPIO_ACTIVE_HIGH | GPIO_PULL_DOWN)>,
                <&gpio1 14 (GPIO_ACTIVE_HIGH | GPIO_PULL_DOWN)>,
                <&gpio1 13 (GPIO_ACTIVE_HIGH | GPIO_PULL_DOWN)>,
                <&gpio1 12 (GPIO_ACTIVE_HIGH | GPIO_PULL_DOWN)>,
                <&gpio0 9 (GPIO_ACTIVE_HIGH | GPIO_PULL_DOWN)>,
                <&gpio0 10 (GPIO_ACTIVE_HIGH | GPIO_PULL_DOWN)>;
};

&soft_off_key {
    gpios = <&gpio0 18 (GPIO_ACTIVE_LOW | GPIO_PULL_UP)>;
};